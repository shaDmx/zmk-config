## boards/arm/corne_choc_pro/corne_choc_pro_left_defconfig
```kconfig
# SPDX-License-Identifier: MIT

CONFIG_SOC_SERIES_NRF52X=y
CONFIG_SOC_NRF52840_QIAA=y
CONFIG_BOARD_CORNE_CHOC_PRO_LEFT=y

# Enable deep sleep
CONFIG_ZMK_SLEEP=y

# Enable MPU
CONFIG_ARM_MPU=y

# Enable GPIO
CONFIG_GPIO=y

CONFIG_USE_DT_CODE_PARTITION=y
CONFIG_BUILD_OUTPUT_UF2=y

CONFIG_MPU_ALLOW_FLASH_WRITE=y
CONFIG_NVS=y
CONFIG_SETTINGS_NVS=y
CONFIG_FLASH=y
CONFIG_FLASH_PAGE_LAYOUT=y
CONFIG_FLASH_MAP=y

CONFIG_ZMK_USB=y
CONFIG_ZMK_BLE=y

# Enable I2C
CONFIG_I2C=y
CONFIG_I2C_NRFX=y
CONFIG_PINCTRL=y

# Enable encoder
CONFIG_EC11=y
CONFIG_EC11_TRIGGER_GLOBAL_THREAD=y

# Enable RGB underglow
CONFIG_WS2812_STRIP=y
CONFIG_ZMK_RGB_UNDERGLOW=y
CONFIG_ZMK_RGB_UNDERGLOW_BRT_MAX=20
CONFIG_ZMK_RGB_UNDERGLOW_HUE_START=48
CONFIG_ZMK_RGB_UNDERGLOW_SAT_START=96

# Windows Battery Reporting Fix
CONFIG_BT_GATT_ENFORCE_SUBSCRIPTION=n

# Ultra-aggressive debounce settings for minimum latency
CONFIG_ZMK_KSCAN_DEBOUNCE_PRESS_MS=0
CONFIG_ZMK_KSCAN_DEBOUNCE_RELEASE_MS=3

# Bluetooth power boost for better connection stability
CONFIG_BT_CTLR_TX_PWR_PLUS_8=y

# Experimental BLE improvements for lower latency
CONFIG_ZMK_BLE_EXPERIMENTAL_CONN=y
CONFIG_BT_CTLR_PHY_2M=n

# Connection interval optimization (7.5ms fixed for minimal latency)
CONFIG_BT_PERIPHERAL_PREF_MIN_INT=6
CONFIG_BT_PERIPHERAL_PREF_MAX_INT=6
CONFIG_BT_PERIPHERAL_PREF_LATENCY=0
CONFIG_BT_PERIPHERAL_PREF_TIMEOUT=42
CONFIG_BT_GAP_AUTO_UPDATE_CONN_PARAMS=y
CONFIG_BT_GAP_PERIPHERAL_PREF_PARAMS=y

# Optimize split keyboard communication
CONFIG_ZMK_SPLIT_BLE_CENTRAL_POSITION_QUEUE_SIZE=10
CONFIG_ZMK_SPLIT_BLE_PERIPHERAL_POSITION_QUEUE_SIZE=20
CONFIG_ZMK_SPLIT_BLE_PERIPHERAL_PRIORITY=7

# Reduce settings save frequency for better performance
CONFIG_ZMK_SETTINGS_SAVE_DEBOUNCE=10000

# Additional nRF52840 radio optimizations
CONFIG_BT_BUF_EVT_RX_COUNT=20
CONFIG_BT_BUF_EVT_RX_SIZE=128

# System optimization for keyboard responsiveness
CONFIG_SYSTEM_WORKQUEUE_PRIORITY=-1

# Ultra-low latency controller optimizations (Agent 1 findings)
CONFIG_BT_CTLR_LOW_LAT=y

# Compilation and speed optimizations
CONFIG_SPEED_OPTIMIZATIONS=y
CONFIG_LTO=y

# Keyboard scan ultra-high priority (Agent 3 findings)
CONFIG_ZMK_KSCAN_INIT_PRIORITY=0
CONFIG_ZMK_KSCAN_EVENT_QUEUE_SIZE=32

# Enhanced HID processing
CONFIG_ZMK_HID_REPORT_QUEUE_SIZE=32
CONFIG_ZMK_ENDPOINT_QUEUE_SIZE=16

# L2CAP and HID optimizations (Agent 2 findings)
CONFIG_BT_L2CAP_TX_BUF_COUNT=8
CONFIG_BT_L2CAP_TX_MTU=65
CONFIG_BT_L2CAP_RX_MTU=65
CONFIG_ZMK_HID_REPORT_TYPE_NKRO=n
CONFIG_ZMK_HID_REPORT_TYPE_HKRO=y

# Radio controller timing optimizations (removed unsupported options)

# Battery level proxy for both halves
CONFIG_ZMK_SPLIT_BLE_CENTRAL_BATTERY_LEVEL_PROXY=y

# Faster boot time and optimized system performance
CONFIG_ZMK_BLE_INIT_PRIORITY=41
CONFIG_SYSTEM_WORKQUEUE_PRIORITY=-1

# Additional nRF52840 radio optimizations

# Enable ZMK Studio (alpha)
CONFIG_ZMK_STUDIO=y

# Enable pointing
CONFIG_ZMK_POINTING=y

# Nuclear option - clear all settings on startup (uncomment if needed)
# CONFIG_ZMK_SETTINGS_RESET_ON_START=y
```
